/* ----------------------------------------------------------------------- */
/*                                                                         */
/*   Quartz Arc                                                            */
/*                                                                         */
/*   STM32 F769I Discovery                                                 */
/*                                                                         */
/*   System: Driver                                                        */
/*   Role: RNG Driver                                                      */
/*   Filename: QAD_RNG.cpp                                                 */
/*   Date: 18th November 2021                                              */
/*   Created By: Benjamin Rosser                                           */
/*                                                                         */
/*   This code is covered by Creative Commons CC-BY-NC-SA license          */
/*   (C) Copyright 2021 Benjamin Rosser                                    */
/*                                                                         */
/* ----------------------------------------------------------------------- */

//Includes
#include "QAD_RNG.hpp"


	//------------------------------------------
	//------------------------------------------
	//------------------------------------------


  //------------------------------
  //------------------------------
  //QAD_RNG Initialization Methods

//QAD_RNG::imp_init
//QAD_RNG Initialization Method
//
//To be called from static method init()
//Used to initialize the RNG peripheral
//Returns QA_OK if the initialization is successful, or QA_Fail if initialization fails
QA_Result QAD_RNG::imp_init(void) {

	//Check peripheral is not already initialized, and return QA_OK if it is
  if (m_eInitState)
  	return QA_OK;

  //Enable RNG Peripheral Clock
  __HAL_RCC_RNG_CLK_ENABLE();
  __HAL_RCC_RNG_FORCE_RESET();
  __HAL_RCC_RNG_RELEASE_RESET();

  //Initialize RNG Peripheral
  m_sHandle.Instance = RNG;
  if (HAL_RNG_Init(&m_sHandle) != HAL_OK) {
  	__HAL_RCC_RNG_CLK_DISABLE();
  	return QA_Fail;
  }

  //Set Driver State as being initialized
  m_eInitState = QA_Initialized;

  //Return
  return QA_OK;
}


//QAD_RNG::imp_deinit
//QAD_RNG Initialization Method
//
//To be called from static method deinit()
//Used to deinitialize the RNG peripheral
void QAD_RNG::imp_deinit(void) {

	//Check peripheral is actually initialized, and return if it is not
  if (!m_eInitState)
  	return;

  //Deinitialize RNG Peripheral
  HAL_RNG_DeInit(&m_sHandle);

  //Disable RNG Peripheral Clock
  __HAL_RCC_RNG_CLK_DISABLE();

  //Set Driver State as not being initialized
  m_eInitState = QA_NotInitialized;
}


  //------------
  //Data Methods

//QAD_RNG::imp_getValue
//QAD_RNG Data Method
//
//To be called from static method getValue()
//Used to retrieve a 32bit random number generated by the RNG peripheral
uint32_t QAD_RNG::imp_getValue(void) {

  //Check peripheral is actually initialized, and return 0 if it is not
	if (!m_eInitState) {
  	return 0;
  }

	//Generate random number and return
	uint32_t uVal = 0;
  HAL_RNG_GenerateRandomNumber(&m_sHandle, &uVal);
  return uVal;
}
